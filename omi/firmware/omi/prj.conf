## prj.conf
```kconfig
CONFIG_SERIAL=y

CONFIG_GPIO=y
CONFIG_INPUT=y
CONFIG_I2C=y
# CONFIG_I2C_SHELL=y
CONFIG_SPI=y
CONFIG_SPI_NOR=y
# CONFIG_SPI_SHELL=y
CONFIG_SETTINGS=y
CONFIG_SETTINGS_NVS=y
CONFIG_NVS=y

CONFIG_PM_DEVICE=y
# CONFIG_PM_DEVICE_RUNTIME=y
CONFIG_ADC=y
CONFIG_ADC_ASYNC=y
CONFIG_ADC_NRFX_SAADC=y
CONFIG_AUDIO=y
CONFIG_AUDIO_DMIC=y
CONFIG_FLASH=y
CONFIG_FLASH_JESD216_API=y
CONFIG_DISK_DRIVER_SDMMC=y
CONFIG_SENSOR=y
CONFIG_REGULATOR=y
CONFIG_ENTROPY_GENERATOR=y

CONFIG_BT=y
CONFIG_BT_SMP=y
CONFIG_BT_PERIPHERAL=y
CONFIG_BT_DIS=n
CONFIG_BT_BAS=n
# CONFIG_BT_DEVICE_NAME="OMI" # configurated bellow
# CONFIG_BT_DEVICE_APPEARANCE=768 # TODO: conflict
CONFIG_CBPRINTF_FP_SUPPORT=y

CONFIG_NCS_SAMPLE_MCUMGR_BT_OTA_DFU=y
CONFIG_MCUMGR_GRP_IMG_ALLOW_ERASE_PENDING=y
# Enable the BT NUS shell
# CONFIG_SHELL=y
# CONFIG_SHELL_BT_NUS=y
# CONFIG_SHELL_BT_NUS_LOG_LEVEL_DBG=y
# CONFIG_SHELL_BACKEND_DUMMY=y

CONFIG_POWEROFF=y

# MCUboot image version. MUST exceed the currently-installed firmware's version
# or MCUboot's downgrade prevention (CONFIG_MCUBOOT_DOWNGRADE_PREVENTION=y)
# silently REVERTS our flash on the test boot — which is exactly why every
# 0.0.0 build this session reverted to the engineer's 3.2.0 image. Bump above
# 3.2.0 so our gesture/5-tap firmware is accepted as an upgrade.
CONFIG_MCUBOOT_IMGTOOL_SIGN_VERSION="3.4.2"

# CONFIG_T5838_LOG_LEVEL_DBG=y
# CONFIG_T5838_AAD_TRIGGER=y

# file system
# CONFIG_MAIN_STACK_SIZE=2048
CONFIG_FILE_SYSTEM=y
# CONFIG_FILE_SYSTEM_EXT2=y

# Enable to allow formatting
CONFIG_FILE_SYSTEM_MKFS=y
CONFIG_FS_FATFS_MKFS=y
# CONFIG_TEST_RANDOM_GENERATOR=y

CONFIG_DISK_ACCESS=y
CONFIG_DISK_DRIVER_SDMMC=y

# FAT filesystem automatically detects partitions
# CONFIG_EXT2_DISK_STARTING_SECTOR=2082

# wifi — DISABLED. The nRF70 WiFi radio + WPA supplicant + networking stack are
# unused by the audio/button/gesture product path, and their radio activity
# contends with BLE servicing (suspected cause of button-event drops + the
# bloated firmware). Disabling at the root lets Kconfig dependency-resolve the
# dependent NET_* options off. Re-enable the whole block when WiFi features ship.
CONFIG_WIFI=n
CONFIG_WIFI_NRF70=n
CONFIG_WIFI_NM_WPA_SUPPLICANT=n
CONFIG_NRF70_AP_MODE=n
CONFIG_NETWORKING=n

# Memories
CONFIG_MAIN_STACK_SIZE=4096

# Kernel options
CONFIG_ENTROPY_GENERATOR=y
CONFIG_POSIX_CLOCK=y

#
# Hardware settings
#

CONFIG_PWM=y
CONFIG_GPIO=y
CONFIG_ADC=y

#
# Audio (new)
#
CONFIG_I2S=y
CONFIG_I2S_NRFX=y
CONFIG_SPI_NRFX=y
CONFIG_AUDIO=y
CONFIG_AUDIO_DMIC=y
CONFIG_AUDIO_DMIC_NRFX_PDM=y
CONFIG_NRFX_PDM0=y  # PDM microphone

# Watchdog Timer
CONFIG_WATCHDOG=y
CONFIG_WDT_DISABLE_AT_BOOT=n

# To flash via dev board
#CONFIG_BUILD_OUTPUT_UF2=n
#CONFIG_USE_DT_CODE_PARTITION=n

#
# Bluetooth settings
#

CONFIG_BT=y
CONFIG_BT_PERIPHERAL=y
CONFIG_BT_MAX_CONN=1
# CONFIG_BT_EXT_ADV_MAX_ADV_SET=2
CONFIG_BT_MAX_PAIRED=1
CONFIG_BT_DEVICE_APPEARANCE=22
CONFIG_BT_GATT_DYNAMIC_DB=y

#
# Max transmit power supported by nRF52840
#

CONFIG_BT_CTLR_TX_PWR_ANTENNA=8
CONFIG_BT_PHY_UPDATE=y

#
# Battery and Device Information services
#

CONFIG_BT_BAS=y
CONFIG_BT_DIS=y
CONFIG_BT_DIS_PNP=n
CONFIG_BT_DEVICE_NAME="Nooto"
CONFIG_BT_DIS_MODEL="Omi CV 1"
CONFIG_BT_DIS_MANUF="Based Hardware"
CONFIG_BT_DIS_FW_REV=y
CONFIG_BT_DIS_HW_REV=y
CONFIG_BT_DIS_FW_REV_STR="3.0.15"
CONFIG_BT_DIS_HW_REV_STR="5.0"

#
# Large BLE packets / BLE Buffers 
#
# CONFIG_BT_GATT_CLIENT=y
# CONFIG_BT_THROUGHPUT=y

CONFIG_BT_L2CAP_TX_MTU=498

CONFIG_BT_CTLR_DATA_LENGTH_MAX=251
CONFIG_BT_CTLR_PHY_2M=y
CONFIG_BT_CTLR_PHY_CODED=y
CONFIG_BT_CTLR_SDC_MAX_CONN_EVENT_LEN_DEFAULT=400000
CONFIG_BT_CONN_TX_MAX=20
CONFIG_BT_L2CAP_TX_BUF_COUNT=10
CONFIG_BT_BUF_ACL_RX_SIZE=1024
CONFIG_BT_BUF_ACL_TX_SIZE=2048
# CONFIG_BT_ATT_TX_COUNT=10
# CONFIG_BT_EXT_ADV=y
# CONFIG_BT_PER_ADV=y
# CONFIG_BT_OBSERVER=y
# CONFIG_BT_ATT_PREPARE_COUNT=2
CONFIG_BT_USER_DATA_LEN_UPDATE=y
CONFIG_BT_USER_PHY_UPDATE=y
CONFIG_BT_AUTO_DATA_LEN_UPDATE=y
CONFIG_BT_AUTO_PHY_UPDATE=y
#CONFIG_BT_GATT_AUTO_UPDATE_MTU=y

CONFIG_BT_GATT_CLIENT=y

# Automatically request preferred connection parameters (default is y, but explicit)
CONFIG_BT_GAP_AUTO_UPDATE_CONN_PARAMS=y

# Set preferred connection parameters
# 7.5ms
CONFIG_BT_PERIPHERAL_PREF_MIN_INT=6
# 30ms
CONFIG_BT_PERIPHERAL_PREF_MAX_INT=24
CONFIG_BT_PERIPHERAL_PREF_LATENCY=0
# 8 seconds (was 4s). Generous tolerance so brief firmware-busy windows (WiFi
# scan, SD-card storage writes) don't drop the link with a supervision timeout
# (GATT reason=8) — the disconnects that wedged the app. The app-side audio
# watchdog also recovers from any drop that still slips through.
CONFIG_BT_PERIPHERAL_PREF_TIMEOUT=800

CONFIG_FPU=y
CONFIG_NORDIC_QSPI_NOR=y
# CONFIG_BOARD_ENABLE_DCDC=y
#

#
# Console
#
# Y to enable console log
CONFIG_CONSOLE=n
CONFIG_PRINTK=n
CONFIG_UART_CONSOLE=n
# CONFIG_SHELL_BACKEND_SERIAL=y

#
# Logs
#

## Enable the lines below to enable logs via UART/USB
# CONFIG_LOG=y
# CONFIG_NET_LOG=y
# CONFIG_LOG_PRINTK=y
# CONFIG_UART_CONSOLE=y
# CONFIG_LOG_PROCESS_THREAD_PRIORITY=5
# CONFIG_LOG_PROCESS_THREAD_CUSTOM_PRIORITY=y
#
# CONFIG_LOG_MODE_IMMEDIATE=y
# CONFIG_SENSOR_LOG_LEVEL_DBG=y
# CONFIG_FLASH_LOG_LEVEL_DBG=y
# CONFIG_FS_LOG_LEVEL_DBG=y
# CONFIG_WIFI_LOG_LEVEL_ERR=y
# CONFIG_WIFI_NRF70_LOG_LEVEL_DBG=y

#
# Enable logging (set level to DBG=4, INF=3, WRN=2, ERR=1)
# CONFIG_LOG_DEFAULT_LEVEL=3

#
# Log level and buffer size
#

# CONFIG_LOG_OVERRIDE_LEVEL=4
# CONFIG_LOG_BUFFER_SIZE=32000
# CONFIG_LOG_PROCESS_THREAD_STACK_SIZE=4096

#
# Debug
#

# CONFIG_DEBUG=y
# CONFIG_DEBUG_OPTIMIZATIONS=y
# CONFIG_SERIAL=y

#
# Debug (This value breaks some builds)
#

# CONFIG_ASSERT=y

#
# BT log configuration
#

# CONFIG_BT_DEBUG_LOG=y
# CONFIG_BT_L2CAP_LOG_LEVEL_DBG=y
# CONFIG_BT_LOG_LEVEL_DBG=y

# CONFIG_BT_RX_STACK_SIZE=4096
# CONFIG_BT_CTLR_RX_PRIO_STACK_SIZE=4096
# CONFIG_BT_DEBUG_LOG=y
# CONFIG_BT_RX_STACK_SIZE=4096
# CONFIG_BT_CTLR_RX_PRIO_STACK_SIZE=4096

#
# SD Card Support (all devices required)
#

CONFIG_DISK_ACCESS=y
CONFIG_FILE_SYSTEM=y

# WARN: was the cause of high battery usage. Need to be checked.
CONFIG_FAT_FILESYSTEM_ELM=y

CONFIG_FS_FATFS_MOUNT_MKFS=y
#CONFIG_FS_FATFS_EXFAT=y
CONFIG_MAIN_STACK_SIZE=4096
# CONFIG_DISK_DRIVER_SDMMC=y
# CONFIG_SPI=y
# CONFIG_HEAP_MEM_POOL_SIZE=512 # disabled by conflicting

#
# Disable unused peripherals
#
CONFIG_I2C=n
# CONFIG_NRFX_TWIM0=n
# CONFIG_NRFX_TWIM1=n

#
# LSM6DSL sensor (accelerometer and gyroscope)
#
CONFIG_LSM6DSL=y
CONFIG_LSM6DSL_ENABLE_TEMP=n
# CONFIG_LSM6DSL_TRIGGER_GLOBAL_THREAD=y
CONFIG_SENSOR=y

#
# Speaker
#
CONFIG_I2S=y
CONFIG_I2S_NRFX=y
CONFIG_SPI_NRFX=y

#
# NFC (in the future)
#

# CONFIG_NFC_T2T_NRFXLIB=y
# CONFIG_NFC_NDEF=y
# CONFIG_NFC_NDEF_MSG=y
# CONFIG_NFC_NDEF_RECORD=y
# CONFIG_NFC_NDEF_URI_MSG=y
# CONFIG_NFC_NDEF_URI_REC=y
# CONFIG_HWINFO=y

#
#EVERYTHING ELSE
#

CONFIG_RING_BUFFER=y

CONFIG_PM_DEVICE=y
# CONFIG_NRFX_USBD=y

# CONFIG_FLASH=y
#

#
# Omi features configuration
#
CONFIG_OMI_CODEC_OPUS=y
CONFIG_OMI_ENABLE_OFFLINE_STORAGE=y
CONFIG_OMI_ENABLE_ACCELEROMETER=n
CONFIG_OMI_ENABLE_BUTTON=y
CONFIG_OMI_ENABLE_SPEAKER=n
CONFIG_OMI_ENABLE_BATTERY=y
CONFIG_OMI_ENABLE_USB=n
CONFIG_OMI_ENABLE_HAPTIC=y
CONFIG_OMI_ENABLE_RFSW_CTRL=y
CONFIG_OMI_ENABLE_MONITOR=n
CONFIG_OMI_ENABLE_WIFI=n
```

## omi.conf
```kconfig
CONFIG_SERIAL=y

CONFIG_GPIO=y
CONFIG_INPUT=y
CONFIG_I2C=y
# CONFIG_I2C_SHELL=y
CONFIG_SPI=y
CONFIG_SPI_NOR=y
# CONFIG_SPI_SHELL=y
CONFIG_SETTINGS=y
CONFIG_SETTINGS_NVS=y
CONFIG_NVS=y

CONFIG_PM_DEVICE=y
# CONFIG_PM_DEVICE_RUNTIME=y
CONFIG_ADC=y
CONFIG_ADC_ASYNC=y
CONFIG_ADC_NRFX_SAADC=y
CONFIG_AUDIO=y
CONFIG_AUDIO_DMIC=y
CONFIG_FLASH=y
CONFIG_FLASH_JESD216_API=y
CONFIG_DISK_DRIVER_SDMMC=y
CONFIG_SENSOR=y
CONFIG_REGULATOR=y
CONFIG_ENTROPY_GENERATOR=y

CONFIG_BT=y
CONFIG_BT_SMP=y
CONFIG_BT_PERIPHERAL=y
CONFIG_BT_DIS=n
CONFIG_BT_BAS=n
# CONFIG_BT_DEVICE_NAME="OMI" # configurated bellow
# CONFIG_BT_DEVICE_APPEARANCE=768 # TODO: conflict
CONFIG_CBPRINTF_FP_SUPPORT=y

CONFIG_NCS_SAMPLE_MCUMGR_BT_OTA_DFU=y
CONFIG_MCUMGR_GRP_IMG_ALLOW_ERASE_PENDING=y
# Enable the BT NUS shell
# CONFIG_SHELL=y
# CONFIG_SHELL_BT_NUS=y
# CONFIG_SHELL_BT_NUS_LOG_LEVEL_DBG=y
# CONFIG_SHELL_BACKEND_DUMMY=y

CONFIG_POWEROFF=y

# CONFIG_T5838_LOG_LEVEL_DBG=y
# CONFIG_T5838_AAD_TRIGGER=y

# file system
# CONFIG_MAIN_STACK_SIZE=2048
CONFIG_FILE_SYSTEM=y
# CONFIG_FILE_SYSTEM_EXT2=y

# Enable to allow formatting
CONFIG_FILE_SYSTEM_MKFS=y
CONFIG_FS_FATFS_MKFS=y
# CONFIG_TEST_RANDOM_GENERATOR=y

CONFIG_DISK_ACCESS=y
CONFIG_DISK_DRIVER_SDMMC=y

# FAT filesystem automatically detects partitions
# CONFIG_EXT2_DISK_STARTING_SECTOR=2082

# wifi
CONFIG_WIFI=n
CONFIG_WIFI_NRF70=n
CONFIG_WIFI_NM_WPA_SUPPLICANT=n
CONFIG_NRF70_AP_MODE=n
CONFIG_NETWORKING=n

# Memories
CONFIG_MAIN_STACK_SIZE=4096

# Kernel options
CONFIG_ENTROPY_GENERATOR=y
CONFIG_POSIX_CLOCK=y

#
# Hardware settings
#

CONFIG_PWM=y
CONFIG_GPIO=y
CONFIG_ADC=y

#
# Audio (new)
#
CONFIG_I2S=y
CONFIG_I2S_NRFX=y
CONFIG_SPI_NRFX=y
CONFIG_AUDIO=y
CONFIG_AUDIO_DMIC=y
CONFIG_AUDIO_DMIC_NRFX_PDM=y
CONFIG_NRFX_PDM0=y  # PDM microphone

# Watchdog Timer
CONFIG_WATCHDOG=y
CONFIG_WDT_DISABLE_AT_BOOT=n

# To flash via dev board
#CONFIG_BUILD_OUTPUT_UF2=n
#CONFIG_USE_DT_CODE_PARTITION=n

#
# Bluetooth settings
#

CONFIG_BT=y
CONFIG_BT_PERIPHERAL=y
CONFIG_BT_MAX_CONN=1
# CONFIG_BT_EXT_ADV_MAX_ADV_SET=2
CONFIG_BT_MAX_PAIRED=1
CONFIG_BT_DEVICE_APPEARANCE=22
CONFIG_BT_GATT_DYNAMIC_DB=y

#
# Max transmit power supported by nRF52840
#

CONFIG_BT_CTLR_TX_PWR_ANTENNA=8
CONFIG_BT_PHY_UPDATE=y

#
# Battery and Device Information services
#

CONFIG_BT_BAS=y
CONFIG_BT_DIS=y
CONFIG_BT_DIS_PNP=n
CONFIG_BT_DEVICE_NAME="Omi"
CONFIG_BT_DIS_MODEL="Omi CV 1"
CONFIG_BT_DIS_MANUF="Based Hardware"
CONFIG_BT_DIS_FW_REV=y
CONFIG_BT_DIS_HW_REV=y
CONFIG_BT_DIS_FW_REV_STR="3.0.15"
CONFIG_BT_DIS_HW_REV_STR="5.0"

#
# Large BLE packets / BLE Buffers 
#
# CONFIG_BT_GATT_CLIENT=y
# CONFIG_BT_THROUGHPUT=y

CONFIG_BT_L2CAP_TX_MTU=498

CONFIG_BT_CTLR_DATA_LENGTH_MAX=251
CONFIG_BT_CTLR_PHY_2M=y
CONFIG_BT_CTLR_PHY_CODED=y
CONFIG_BT_CTLR_SDC_MAX_CONN_EVENT_LEN_DEFAULT=400000
CONFIG_BT_CONN_TX_MAX=20
CONFIG_BT_L2CAP_TX_BUF_COUNT=10
CONFIG_BT_BUF_ACL_RX_SIZE=1024
CONFIG_BT_BUF_ACL_TX_SIZE=2048
# CONFIG_BT_ATT_TX_COUNT=10
# CONFIG_BT_EXT_ADV=y
# CONFIG_BT_PER_ADV=y
# CONFIG_BT_OBSERVER=y
# CONFIG_BT_ATT_PREPARE_COUNT=2
CONFIG_BT_USER_DATA_LEN_UPDATE=y
CONFIG_BT_USER_PHY_UPDATE=y
CONFIG_BT_AUTO_DATA_LEN_UPDATE=y
CONFIG_BT_AUTO_PHY_UPDATE=y
#CONFIG_BT_GATT_AUTO_UPDATE_MTU=y

CONFIG_BT_GATT_CLIENT=y

# Automatically request preferred connection parameters (default is y, but explicit)
CONFIG_BT_GAP_AUTO_UPDATE_CONN_PARAMS=y

# Set preferred connection parameters
# 7.5ms
CONFIG_BT_PERIPHERAL_PREF_MIN_INT=6
# 30ms
CONFIG_BT_PERIPHERAL_PREF_MAX_INT=24
CONFIG_BT_PERIPHERAL_PREF_LATENCY=0
# 8 seconds (was 4s) — more tolerance for firmware-busy windows so a brief stall doesn't drop the link (GATT reason=8)
CONFIG_BT_PERIPHERAL_PREF_TIMEOUT=800

CONFIG_FPU=y
CONFIG_NORDIC_QSPI_NOR=y
# CONFIG_BOARD_ENABLE_DCDC=y
#

#
# Console
#
# Y to enable console log
CONFIG_CONSOLE=n
CONFIG_PRINTK=n
CONFIG_UART_CONSOLE=n
# CONFIG_SHELL_BACKEND_SERIAL=y

#
# Logs
#

## Enable the lines below to enable logs via UART/USB
# CONFIG_LOG=y
# CONFIG_NET_LOG=y
# CONFIG_LOG_PRINTK=y
# CONFIG_UART_CONSOLE=y
# CONFIG_LOG_PROCESS_THREAD_PRIORITY=5
# CONFIG_LOG_PROCESS_THREAD_CUSTOM_PRIORITY=y
#
# CONFIG_LOG_MODE_IMMEDIATE=y
# CONFIG_SENSOR_LOG_LEVEL_DBG=y
# CONFIG_FLASH_LOG_LEVEL_DBG=y
# CONFIG_FS_LOG_LEVEL_DBG=y
# CONFIG_WIFI_LOG_LEVEL_ERR=y
# CONFIG_WIFI_NRF70_LOG_LEVEL_DBG=y

#
# Enable logging (set level to DBG=4, INF=3, WRN=2, ERR=1)
# CONFIG_LOG_DEFAULT_LEVEL=3

#
# Log level and buffer size
#

# CONFIG_LOG_OVERRIDE_LEVEL=4
# CONFIG_LOG_BUFFER_SIZE=32000
# CONFIG_LOG_PROCESS_THREAD_STACK_SIZE=4096

#
# Debug
#

# CONFIG_DEBUG=y
# CONFIG_DEBUG_OPTIMIZATIONS=y
# CONFIG_SERIAL=y

#
# Debug (This value breaks some builds)
#

# CONFIG_ASSERT=y

#
# BT log configuration
#

# CONFIG_BT_DEBUG_LOG=y
# CONFIG_BT_L2CAP_LOG_LEVEL_DBG=y
# CONFIG_BT_LOG_LEVEL_DBG=y

# CONFIG_BT_RX_STACK_SIZE=4096
# CONFIG_BT_CTLR_RX_PRIO_STACK_SIZE=4096
# CONFIG_BT_DEBUG_LOG=y
# CONFIG_BT_RX_STACK_SIZE=4096
# CONFIG_BT_CTLR_RX_PRIO_STACK_SIZE=4096

#
# SD Card Support (all devices required)
#

CONFIG_DISK_ACCESS=y
CONFIG_FILE_SYSTEM=y

# WARN: was the cause of high battery usage. Need to be checked.
CONFIG_FAT_FILESYSTEM_ELM=y

CONFIG_FS_FATFS_MOUNT_MKFS=y
#CONFIG_FS_FATFS_EXFAT=y
CONFIG_MAIN_STACK_SIZE=4096
# CONFIG_DISK_DRIVER_SDMMC=y
# CONFIG_SPI=y
# CONFIG_HEAP_MEM_POOL_SIZE=512 # disabled by conflicting

#
# Disable unused peripherals
#
CONFIG_I2C=n
# CONFIG_NRFX_TWIM0=n
# CONFIG_NRFX_TWIM1=n

#
# LSM6DSL sensor (accelerometer and gyroscope)
#
CONFIG_LSM6DSL=y
CONFIG_LSM6DSL_ENABLE_TEMP=n
# CONFIG_LSM6DSL_TRIGGER_GLOBAL_THREAD=y
CONFIG_SENSOR=y

#
# Speaker
#
CONFIG_I2S=y
CONFIG_I2S_NRFX=y
CONFIG_SPI_NRFX=y

#
# NFC (in the future)
#

# CONFIG_NFC_T2T_NRFXLIB=y
# CONFIG_NFC_NDEF=y
# CONFIG_NFC_NDEF_MSG=y
# CONFIG_NFC_NDEF_RECORD=y
# CONFIG_NFC_NDEF_URI_MSG=y
# CONFIG_NFC_NDEF_URI_REC=y
# CONFIG_HWINFO=y

#
#EVERYTHING ELSE
#

CONFIG_RING_BUFFER=y

CONFIG_PM_DEVICE=y
# CONFIG_NRFX_USBD=y

# CONFIG_FLASH=y
#

#
# Omi features configuration
#
CONFIG_OMI_CODEC_OPUS=y
CONFIG_OMI_ENABLE_OFFLINE_STORAGE=y
CONFIG_OMI_ENABLE_ACCELEROMETER=n
CONFIG_OMI_ENABLE_BUTTON=y
CONFIG_OMI_ENABLE_SPEAKER=n
CONFIG_OMI_ENABLE_BATTERY=y
CONFIG_OMI_ENABLE_USB=n
CONFIG_OMI_ENABLE_HAPTIC=y
CONFIG_OMI_ENABLE_RFSW_CTRL=y
CONFIG_OMI_ENABLE_MONITOR=n
CONFIG_OMI_ENABLE_WIFI=n
```

## src/main.c
```c
#include <zephyr/kernel.h>
#include <zephyr/logging/log.h>
#include <zephyr/pm/device_runtime.h>
#include <zephyr/shell/shell.h>

#include "lib/core/button.h"
#include "lib/core/codec.h"
#include "lib/core/config.h"
#include "lib/core/feedback.h"
#include "lib/core/haptic.h"
#include "lib/core/led.h"
#include "lib/core/lib/battery/battery.h"
#include "lib/core/mic.h"
#ifdef CONFIG_OMI_ENABLE_MONITOR
#include "lib/core/monitor.h"
#endif
#include "lib/core/settings.h"
#include "lib/core/transport.h"
#ifdef CONFIG_OMI_ENABLE_OFFLINE_STORAGE
#include "lib/core/storage.h"
#endif
#include <hal/nrf_reset.h>
#include "rtc.h"
#include "imu.h"

#include "lib/core/sd_card.h"
#include "spi_flash.h"
#include "wdog_facade.h"

LOG_MODULE_REGISTER(main, CONFIG_LOG_DEFAULT_LEVEL);

#ifdef CONFIG_OMI_ENABLE_BATTERY
#define BATTERY_FULL_THRESHOLD_PERCENT 98 // 98%
extern uint8_t battery_percentage;
#endif
bool is_connected = false;
bool is_charging = false;
bool is_off = false;
bool blink_toggle = false;

static void print_reset_reason(void)
{
    uint32_t reas;

    reas = nrf_reset_resetreas_get(NRF_RESET);
    nrf_reset_resetreas_clear(NRF_RESET, reas);

    if (reas & NRF_RESET_RESETREAS_DOG0_MASK) {
        printk("Reset by WATCHDOG\n");
    } else if (reas & NRF_RESET_RESETREAS_NFC_MASK) {
        printk("Wake up by NFC field detect\n");
    } else if (reas & NRF_RESET_RESETREAS_RESETPIN_MASK) {
        printk("Reset by pin-reset\n");
    } else if (reas & NRF_RESET_RESETREAS_SREQ_MASK) {
        printk("Reset by soft-reset\n");
    } else if (reas & NRF_RESET_RESETREAS_LOCKUP_MASK) {
        printk("Reset by CPU LOCKUP\n");
    } else if (reas) {
        printk("Reset by a different source (0x%08X)\n", reas);
    } else {
        printk("Power-on-reset\n");
    }
}

static void codec_handler(uint8_t *data, size_t len)
{
#ifdef CONFIG_OMI_ENABLE_MONITOR
    monitor_inc_broadcast_audio();
#endif
    int err = broadcast_audio_packets(data, len);
    if (err) {
#ifdef CONFIG_OMI_ENABLE_MONITOR
        monitor_inc_broadcast_audio_failed();
#endif
    }
}

static void mic_handler(int16_t *buffer)
{
#ifdef CONFIG_OMI_ENABLE_MONITOR
    // Track total bytes processed (each sample is 2 bytes)
    monitor_inc_mic_buffer();
#endif

    int err = codec_receive_pcm(buffer, MIC_BUFFER_SAMPLES);
    if (err) {
        LOG_ERR("Failed to process PCM data: %d", err);
    }
}

static void boot_led_sequence(void)
{
    // Quick blue pulse = "I'm alive, booting..."
    set_led_blue(true);
    k_msleep(300);
    led_off();
}

static void boot_ready_sequence(void)
{
    const int steps = 50;
    const int delay_ms = 10;

    // Smooth green fade in/out 2 times = "Ready!"
    for (int cycle = 0; cycle < 2; cycle++) {
        // Fade in: ease-in-out
        for (int i = 0; i <= steps; i++) {
            float t = (float) i / steps;
            // Ease-in-out quadratic
            float eased = t < 0.5f ? 2.0f * t * t : 1.0f - 2.0f * (1.0f - t) * (1.0f - t);
            uint8_t level = (uint8_t) (eased * 50.0f);
            set_led_pwm(LED_GREEN, level);
            k_msleep(delay_ms);
        }

        // Fade out: ease-in-out
        for (int i = 0; i <= steps; i++) {
            float t = (float) i / steps;
            float eased = t < 0.5f ? 2.0f * t * t : 1.0f - 2.0f * (1.0f - t) * (1.0f - t);
            uint8_t level = (uint8_t) ((1.0f - eased) * 70.0f);
            set_led_pwm(LED_GREEN, level);
            k_msleep(delay_ms);
        }
    }
    k_msleep(10);
    led_off();
    k_msleep(10);
}

void set_led_state()
{
    // If device is off, turn off all LEDs immediately
    if (is_off) {
        led_off();
        return;
    }

    bool green = false;
    bool blue = false;
    bool red = false;

    // Muted takes priority over the connection/charging color: solid red =
    // "mic off / off air". Without this, the 1Hz LED refresh overwrote the
    // app's mute-LED command every second (it only blinked red, never latched).
    if (is_muted()) {
        set_led_green(false);
        set_led_blue(false);
        set_led_red(true);
        return;
    }

    if (is_charging) {
#ifdef CONFIG_OMI_ENABLE_BATTERY
        // Solid green if battery is full (>= BATTERY_FULL_THRESHOLD_PERCENT)
        if (battery_percentage >= BATTERY_FULL_THRESHOLD_PERCENT) {
            green = true;
        } else
#endif
        {
            green = blink_toggle;
            blue = !blink_toggle && is_connected;
            red = !blink_toggle && !is_connected;
            blink_toggle = !blink_toggle;
        }
    } else {
        blue = is_connected;
        red = !is_connected;
    }

    set_led_green(green);
    set_led_blue(blue);
    set_led_red(red);
}

static int suspend_unused_modules(void)
{
    int err = flash_off();
    if (err) {
        LOG_ERR("Can not suspend the spi flash module: %d", err);
    }

    return 0;
}

int main(void)
{
    int ret;
    printk("Starting omi ...\n");

    // print reset reason at startup
    print_reset_reason();

    // Initialize watchdog first to catch any early freezes
    ret = watchdog_init();
    if (ret) {
        LOG_WRN("Watchdog init failed (err %d), continuing without watchdog", ret);
    }

    // Initialize Haptic driver first; this is building up for future of omi turn on sequence - long press to turn on
    // instead of short press
#ifdef CONFIG_OMI_ENABLE_HAPTIC
    ret = haptic_init();
    if (ret) {
        LOG_ERR("Failed to initialize Haptic driver (err %d)", ret);
        error_haptic();
        // Non-critical, continue boot
    } else {
        LOG_INF("Haptic driver initialized");
        play_haptic_milli(100);
    }
#endif

    // Initialize LEDs
    LOG_INF("Initializing LEDs...\n");

    ret = led_start();
    if (ret) {
        LOG_ERR("Failed to initialize LEDs (err %d)", ret);
        error_led_driver();
        return ret;
    }

    // Suspend unused modules
    LOG_PRINTK("\n");
    LOG_INF("Suspending unused modules...\n");
    ret = suspend_unused_modules();
    if (ret) {
        LOG_ERR("Failed to suspend unused modules (err %d)", ret);
        ret = 0;
    }

    // Initialize settings
    LOG_INF("Initializing settings...\n");
    int setting_ret = app_settings_init();
    if (setting_ret) {
        LOG_ERR("Failed to initialize settings (err %d)", setting_ret);
    }

    // Initialize RTC from saved epoch
    init_rtc();
    if (!rtc_is_valid()) {
        LOG_WRN("UTC time not synchronized yet");
    }

    (void)lsm6dsl_time_boot_adjust_rtc();

#ifdef CONFIG_OMI_ENABLE_MONITOR
    // Initialize monitoring system
    LOG_INF("Initializing monitoring system...\n");
    ret = monitor_init();
    if (ret) {
        LOG_ERR("Failed to initialize monitoring system (err %d)", ret);
    }
#endif

    if (setting_ret) {
        error_settings();
        app_settings_save_dim_ratio(30);
    }

    // Initialize battery
#ifdef CONFIG_OMI_ENABLE_BATTERY
    ret = battery_init();
    if (ret) {
        LOG_ERR("Battery init failed (err %d)", ret);
        error_battery_init();
        return ret;
    }

    ret = battery_charge_start();
    if (ret) {
        LOG_ERR("Battery failed to start (err %d)", ret);
        error_battery_charge();
        return ret;
    }
    LOG_INF("Battery initialized");
#endif

    // Initialize button
#ifdef CONFIG_OMI_ENABLE_BUTTON
    ret = button_init();
    if (ret) {
        LOG_ERR("Failed to initialize Button (err %d)", ret);
        error_button();
        return ret;
    }
    LOG_INF("Button initialized");
    activate_button_work();
#endif

    // SD Card
    ret = app_sd_init();
    if (ret) {
        LOG_ERR("Failed to initialize SD Card (err %d)", ret);
        error_sd_card();
        return ret;
    }

#ifdef CONFIG_OMI_ENABLE_OFFLINE_STORAGE
    // Initialize storage service for offline audio
    ret = storage_init();
    if (ret) {
        LOG_ERR("Failed to initialize storage service (err %d)", ret);
        error_storage();
        // Non-critical, continue boot
    } else {
        LOG_INF("Storage service initialized");
    }
#endif

    // Indicate transport initialization
    LOG_PRINTK("\n");
    LOG_INF("Initializing transport...\n");

    // Start transport
    int transportErr;
    transportErr = transport_start();
    if (transportErr) {
        LOG_ERR("Failed to start transport (err %d)", transportErr);
        error_transport();
        return transportErr;
    }

    // Initialize codec
    LOG_INF("Initializing codec...\n");

    // Set codec callback
    set_codec_callback(codec_handler);
    ret = codec_start();
    if (ret) {
        LOG_ERR("Failed to start codec: %d", ret);
        error_codec();
        return ret;
    }

    // Initialize microphone
    LOG_INF("Initializing microphone...\n");
    set_mic_callback(mic_handler);
    ret = mic_start();
    if (ret) {
        LOG_ERR("Failed to start microphone: %d", ret);
        error_microphone();
        return ret;
    }
#ifdef CONFIG_OMI_ENABLE_WIFI
    // Initialize wifi
    wifi_init();
#endif
    LOG_INF("Device initialized successfully\n");

    while (1) {
        watchdog_feed();
#ifdef CONFIG_OMI_ENABLE_MONITOR
        monitor_log_metrics();
#endif

        set_led_state();
        k_msleep(1000);
// Print current UTC time every second for debugging
#ifdef CONFIG_LOG
        char utc_str[RTC_UTC_DATETIME_STRLEN];
        int fmt_err = rtc_format_now_utc_datetime(utc_str, sizeof(utc_str));
        if (fmt_err) {
            LOG_INF("Current UTC time: <unsynced>");
        } else {
            LOG_INF("Current UTC time: %s", utc_str);
        }
#endif
    }

    printk("Exiting omi...");
    return 0;
}
```
